/*
 * Whisplay Hat+ aggregate overlay.
 *
 * This top-level overlay includes display/touch, sound and sensor fragments.
 */

/dts-v1/;
/plugin/;

/ {
	compatible = "brcm,bcm2837", "brcm,bcm2711", "brcm,bcm2712";

#include "../display/dts/display.dtsi"
#include "../sound/dts/sound.dtsi"
#include "../sensors/sensors.dtsi"

	/*
	 * Grove Port.X interface select: physical low selects I2C (the default),
	 * while physical high selects UART. The port_x_uart override toggles the
	 * GPIO polarity so that the logical low becomes a physical high.
	 */
	fragment@11 {
		target = <&gpio>;

		__overlay__ {
			port_x_select: port-x-select {
				gpio-hog;
				gpios = <27 0>;
				output-low;
				line-name = "grove-port-x-select";
			};
		};
	};

	__overrides__ {
		display_dsi = <0>,"!0!1!2=3=4=5";
		backlight_active_low = <&panel0>,"ledc-gpios:8",
				       <&panel1>,"ledc-gpios:8";
		/* Toggle GPIO_ACTIVE_LOW in the gpio-hog's flags cell. */
		port_x_uart = <&port_x_select>,"gpios:4";
	};
};
